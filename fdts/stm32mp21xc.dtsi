// SPDX-License-Identifier: (GPL-2.0-only OR BSD-3-Clause)
/*
 * Copyright (C) STMicroelectronics 2024 - All Rights Reserved
 * Author: Alexandre Torgue <alexandre.torgue@foss.st.com> for STMicroelectronics.
 */

/ {
        soc@0 {
		saes: saes@42030c00 {
			compatible = "st,stm32-saes";
			reg = <0x42030c00 0x400>;
			clocks = <&rcc CK_BUS_SAES>;
			resets = <&rcc SAES_R>;
			status = "disabled";
		};

		pka: pka@42032000 {
			compatible = "st,stm32mp13-pka64";
			reg = <0x42032000 0x2000>;
			clocks = <&rcc CK_BUS_PKA>;
			resets = <&rcc PKA_R>;
			status = "disabled";
		};
	};
};
