// SPDX-License-Identifier: (GPL-2.0+ OR BSD-3-Clause)
/*
 * Copyright (C) MYiR 2023 - All Rights Reserved
 * Author: Alexhu <fan.hu@myirtech.com>
 */

/dts-v1/;

#include "myb-stm32mp135x-base.dts"
#include "stm32mp13-ddr3-1x4Gb-1066-binF.dtsi"

/ {
	model = "STMicroelectronics STM32MP135F-DK Discovery Board";
	compatible = "st,stm32mp135f-dk", "st,stm32mp135";

	aliases {
		serial0 = &uart4;
	};

	chosen {
		stdout-path = "serial0:115200n8";
	};

        memory@c0000000 {
                device_type = "memory";
                reg = <0xc0000000 0x20000000>;
        };

};
